## CMakeLists.txt
```
cmake_minimum_required(VERSION 3.20.0)

# Set board if not specified
if(NOT DEFINED BOARD)
    set(BOARD nrf52840dk_nrf52840)
endif()

find_package(Zephyr REQUIRED HINTS $ENV{ZEPHYR_BASE})
project(zephyr_firmware)

# Include directories
target_include_directories(app PRIVATE src)

# Source files
target_sources(app PRIVATE
    src/main.c
    # Add more source files here
)

# Compiler flags
target_compile_options(app PRIVATE
    -Wall
    -Wextra
    -Werror
)
```

## prj.conf
```kconfig
# Debug configuration
CONFIG_LOG=y
CONFIG_LOG_DEFAULT_LEVEL=3
CONFIG_ASSERT=y
CONFIG_DEBUG=y
CONFIG_DEBUG_INFO=y

# Nordic specific
CONFIG_NORDIC_QSPI_NOR=y
CONFIG_NORDIC_QSPI_NOR_FLASH_LAYOUT_PAGE_SIZE=4096

# Networking (if applicable)
CONFIG_NETWORKING=y
CONFIG_NET_L2_ETHERNET=y

# USB (if applicable)
CONFIG_USB_DEVICE_STACK=y
CONFIG_USB_DEVICE_PRODUCT="Zephyr Firmware"
```

## prj_release.conf
```kconfig
# Release configuration - minimal logging
CONFIG_LOG=n
CONFIG_ASSERT=n
CONFIG_DEBUG=n
CONFIG_SPEED_OPTIMIZATIONS=y
CONFIG_SIZE_OPTIMIZATIONS=y

# Nordic specific
CONFIG_NORDIC_QSPI_NOR=y
CONFIG_NORDIC_QSPI_NOR_FLASH_LAYOUT_PAGE_SIZE=4096

# Networking (if applicable)
CONFIG_NETWORKING=y
CONFIG_NET_L2_ETHERNET=y
```

## src/main.c
```c
#include <zephyr/kernel.h>
#include <zephyr/logging/log.h>

LOG_MODULE_REGISTER(main, LOG_LEVEL_INF);

int main(void)
{
    LOG_INF("Hello, Zephyr test!");

    // Main loop
    while (1) {
        // Perform periodic tasks or sleep
        k_sleep(K_SECONDS(1));
    }

    return 0; // This line is never reached
}
```
