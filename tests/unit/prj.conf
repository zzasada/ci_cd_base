## CMakeLists.txt
```
cmake_minimum_required(VERSION 3.20.0)

find_package(Zephyr REQUIRED HINTS $ENV{ZEPHYR_BASE})
project(unit_tests)

# Include main app source (exclude main.c)
target_include_directories(app PRIVATE 
    ../../app/src
)

# Test source files
target_sources(app PRIVATE
    src/test_main.c
    # Add more test files here
)
```

## prj.conf
```kconfig
CONFIG_ZTEST=y
CONFIG_ZTEST_NEW_API=y
CONFIG_LOG=y
CONFIG_LOG_DEFAULT_LEVEL=3
```

## src/test_main.c
```c
#include <zephyr/ztest.h>

ZTEST(basic_tests, test_simple)
{
    zassert_equal(1, 1, "Basic test should pass");
}

ZTEST_SUITE(basic_tests, NULL, NULL, NULL, NULL, NULL);
```
