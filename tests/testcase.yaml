## tests/testcase.yaml
```yaml
tests:
  my_blinky.unit_tests:
    tags: unit_test
    platform_allow:
      - native_sim
      - native_posix
      - qemu_x86
    integration_platforms:
      - native_sim
```

## west.yml
```yaml
manifest:
  self:
    path: .

  remotes:
    - name: ncs
      url-base: https://github.com/nrfconnect
    - name: zephyr
      url-base: https://github.com/zephyrproject-rtos

  projects:
    - name: nrf
      remote: ncs
      revision: v3.0.1
      path: nrf
    - name: zephyr
      remote: zephyr
      revision: v3.4.0
      path: zephyr
      west-commands: scripts/west-commands.yml
      import: true
    - name: mcuboot
      remote: ncs
      revision: v3.0.1
      path: bootloader/mcuboot
```
